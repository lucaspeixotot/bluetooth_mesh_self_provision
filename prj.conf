## CMakeLists.txt
```
cmake_minimum_required(VERSION 3.8.2)

set(BOARD nrf52840_pca10056)
include($ENV{ZEPHYR_BASE}/cmake/app/boilerplate.cmake NO_POLICY_SCOPE)

project(bluetooth_mesh_self_provision)

# Generate version file
include(build.version.cmake NO_POLICY_SCOPE)

# Schedule a new version file generation after every build
add_custom_command(
    TARGET app
    POST_BUILD
    COMMAND "${CMAKE_COMMAND}"
    -DPROJECT_SOURCE_DIR=${PROJECT_SOURCE_DIR}
    -DPROJECT_BINARY_DIR=${PROJECT_BINARY_DIR}
    -P ${PROJECT_SOURCE_DIR}/build.version.cmake
    )

list(APPEND HEADERS
    "${PROJECT_BINARY_DIR}/include/generated"
    "${PROJECT_BINARY_DIR}/zephyr/include/generated"
    "${PROJECT_SOURCE_DIR}/include"
    )

list(APPEND SOURCES
    "${PROJECT_SOURCE_DIR}/src/main.c"
    "${PROJECT_SOURCE_DIR}/src/ic_version.c"
    "${PROJECT_SOURCE_DIR}/src/ic_leds.c"
    "${PROJECT_SOURCE_DIR}/src/ic_bt.c"
    "${PROJECT_SOURCE_DIR}/src/ic_buttons.c"
    )

include_directories(${HEADERS})
target_sources(app PRIVATE ${SOURCES})
```

## prj.conf
```kconfig
#CONFIG_INIT_STACKS=y
CONFIG_MAIN_STACK_SIZE=512
#CONFIG_SYSTEM_WORKQUEUE_STACK_SIZE=1280
CONFIG_SYSTEM_WORKQUEUE_STACK_SIZE=2048
CONFIG_SYS_CLOCK_TICKS_PER_SEC=250
CONFIG_GPIO=y
CONFIG_FLASH=y
CONFIG_DISPLAY=y
CONFIG_MICROBIT_DISPLAY=y

CONFIG_BT=y
CONFIG_BT_RX_STACK_SIZE=1280
CONFIG_BT_CTLR_DUP_FILTER_LEN=0
CONFIG_BT_OBSERVER=y
CONFIG_BT_BROADCASTER=y

CONFIG_BT_MESH=y
CONFIG_BT_MESH_RELAY=n
CONFIG_BT_MESH_RX_SDU_MAX=36
CONFIG_BT_MESH_SUBNET_COUNT=1
CONFIG_BT_MESH_APP_KEY_COUNT=5
CONFIG_BT_MESH_MODEL_KEY_COUNT=2
CONFIG_BT_MESH_MODEL_GROUP_COUNT=2
CONFIG_BT_MESH_LABEL_COUNT=3
CONFIG_BT_MESH_ADV_BUF_COUNT=40
CONFIG_BT_MESH_PB_ADV=n
CONFIG_BT_MESH_CFG_CLI=y

CONFIG_BT_DEBUG_LOG=y
CONFIG_BT_MESH_DEBUG_ACCESS=y
CONFIG_BT_MESH_DEBUG=y

CONFIG_PRINTK=y
CONFIG_HEAP_MEM_POOL_SIZE=256
CONFIG_ASSERT=y
```

## src/main.c
```c
/**
 * @file ic_bt.h
 * @Lucas Peixoto (lpdac@ic.ufal.br)
 * @brief
 * @version 0.1
 * @date 2018-12-25
 *
 * @copyright Copyright (c) 2018
 *
 */
#include <misc/printk.h>
#include <zephyr.h>

#include "ic_bt.h"
#include "ic_buttons.h"
#include "ic_leds.h"
#include "ic_version.h"

#define SLEEP_TIME 250
#define PRIORITY 7
#define STACKSIZE 1024

// LED STUFF ------------------------------------------------------------------
u8_t leds_states[4]       = {0};
ic_leds_device_t leds_dev = {0};

// BUTTON STUFF ---------------------------------------------------------------
struct k_work pressed_work[BUTTON_NUMBERS];
ic_buttons_device_t buttons_dev;
u32_t time      = 0;
u32_t last_time = 0;

// BLE STUFF ------------------------------------------------------------------

// Addresses

#define ROOT_ADDR 0x00e1
#define LED_ADDR 0x00e2
#define BUTTON_ADDR 0x00e3

#define GROUP_ADDR 0xcea0
#define GROUP_PUB_ADDR 0xcae0

static const uint8_t dev_uuid[16] = {0xcf, 0xa0, 0xea, 0x7e, 0x17, 0xd9, 0x11, 0xe8,
                                     0x86, 0xd1, 0x5f, 0x1c, 0xe2, 0x8a, 0xde, 0xa7};

// Security keys
static const u8_t net_key[16] = {
    0x01, 0x23, 0x45, 0x67, 0x89, 0xab, 0xcd, 0xef, 0x01, 0x23, 0x45, 0x67, 0x89, 0xab, 0xcd, 0xef,
};
static const u8_t dev_key[16] = {
    0x01, 0x23, 0x45, 0x67, 0x89, 0xab, 0xcd, 0xef, 0x01, 0x23, 0x45, 0x67, 0x89, 0xab, 0xcd, 0xef,
};
static const u8_t app_key[16] = {
    0x01, 0x23, 0x45, 0x67, 0x89, 0xab, 0xcd, 0xef, 0x01, 0x23, 0x45, 0x67, 0x89, 0xab, 0xcd, 0xef,
};

// Variables for configuration and self provisioning
static const u16_t net_idx;
static const u16_t app_idx;
static const u32_t iv_index;
static u8_t flags;

// Node construction
// 2 bytes for opcode
// 1 byte for msg
// 1 byte for delay e etc
BT_MESH_MODEL_PUB_DEFINE(pub_onoff_srv, NULL, 2 + 2);
BT_MESH_MODEL_PUB_DEFINE(pub_onoff_cli, NULL, 2 + 2);

// Health server model
BT_MESH_HEALTH_PUB_DEFINE(health_pub, 0);

// Defining config server
static struct bt_mesh_cfg_srv cfg_srv = {
    .relay            = BT_MESH_RELAY_DISABLED,
    .beacon           = BT_MESH_BEACON_ENABLED,
    .frnd             = BT_MESH_FRIEND_NOT_SUPPORTED,
    .gatt_proxy       = BT_MESH_GATT_PROXY_ENABLED,
    .default_ttl      = 7,
    .net_transmit     = BT_MESH_TRANSMIT(2, 20),
    .relay_retransmit = BT_MESH_TRANSMIT(2, 20),
};


static struct bt_mesh_health_srv health_srv = {};
static struct bt_mesh_cfg_cli cfg_cli       = {};
static void set_state(u8_t state)
{
    if (!state) {
        ic_leds_turn_on_led(&leds_dev, LED0);
    } else {
        ic_leds_turn_off_led(&leds_dev, LED0);
    }
}

static struct onoff_srv led_onoff_elems[] = {
    {
        .state     = &leds_states[0],
        .tid       = 0,
        .set_state = set_state,
    },
};

static struct onoff_cli cli_onoff_elems[] = {
    {
        .state = 0,
        .tid   = 0,
    },
};

static struct bt_mesh_model root_models[] = {
    BT_MESH_MODEL_CFG_SRV(&cfg_srv),
    BT_MESH_MODEL_CFG_CLI(&cfg_cli),
    BT_MESH_MODEL_HEALTH_SRV(&health_srv, &health_pub),
};

static struct bt_mesh_model led_models[] = {
    BT_MESH_MODEL(BT_MESH_MODEL_ID_GEN_ONOFF_SRV, generic_onoff_srv_op, &pub_onoff_srv,
                  &led_onoff_elems[0]),
};

static struct bt_mesh_model button_models[] = {
    BT_MESH_MODEL(BT_MESH_MODEL_ID_GEN_ONOFF_CLI, generic_onoff_cli_op, &pub_onoff_cli,
                  &cli_onoff_elems[0]),
};
struct bt_mesh_elem elements[] = {
    BT_MESH_ELEM(0, root_models, BT_MESH_MODEL_NONE),
    BT_MESH_ELEM(0, led_models, BT_MESH_MODEL_NONE),
    BT_MESH_ELEM(0, button_models, BT_MESH_MODEL_NONE),
};

static const struct bt_mesh_comp comp = {
    .cid        = BT_COMP_ID_LF,
    .elem       = elements,
    .elem_count = ARRAY_SIZE(elements),
};

static const struct bt_mesh_prov prov = {
    .uuid = dev_uuid,
};


// BOARD STUFF ----------------------------------------------------------------

void button1_handler(struct k_work *work)
{
    printk("Button 1 handler started.\n");
    struct onoff_cli *h = CONTAINER_OF(work, struct onoff_cli, callback_work);
    h->act              = !h->state;
    send_generic_onoff_set(h, BT_MESH_MODEL_OP_GENERIC_ONOFF_SET);
}

void ic_buttons_callback(struct device *buttons_device, struct gpio_callback *callback,
                         u32_t button_pin_mask)
{
    time = k_uptime_get_32();

    if (time < last_time + BUTTON_DEBOUNCE_DELAY_MS) {
        last_time = time;
        return;
    }

    if (ic_buttons_pin_to_i(button_pin_mask) == 0) {
        printk("Button 1 was pressed.\n");
        k_work_submit(&cli_onoff_elems[0].callback_work);
    } else if (ic_buttons_pin_to_i(button_pin_mask) == 1) {
        printk("The button 2 was not configured.\n");
    } else if (ic_buttons_pin_to_i(button_pin_mask) == 2) {
        printk("The button 3 was not configured.\n");
    } else if (ic_buttons_pin_to_i(button_pin_mask) == 3) {
        printk("The button 4 was not configured.\n");
    }
    last_time = time;
}

static int configure_board()
{
    int err;

    // Led configuration
    err = ic_leds_init_device(&leds_dev);
    if (err) {
        printk("Error initializing leds device\n");
        return err;
    }

    err = ic_leds_configure(&leds_dev);
    if (err) {
        printk("Error configuring leds device\n");
        return err;
    }

    ic_leds_turn_off_led(&leds_dev, LED1);
    ic_leds_turn_off_led(&leds_dev, LED2);
    ic_leds_turn_off_led(&leds_dev, LED3);

    // Button configuration
    ic_buttons_init_device(&buttons_dev);
    ic_buttons_configure(&buttons_dev);
    ic_buttons_configure_callback(&buttons_dev, ic_buttons_callback);
    cli_onoff_elems[0].callback_work = pressed_work[0];
    cli_onoff_elems[0].model_cli     = &button_models[0];
    k_work_init(&cli_onoff_elems[0].callback_work, button1_handler);

    return 0;
}

static int self_provision()
{
    // now we provision ourselves... this is not how it would normally be done!
    int err = bt_mesh_provision(net_key, net_idx, flags, iv_index, ROOT_ADDR, dev_key);
    if (err) {
        printk("Provisioning failed (err %d)\n", err);
        return err;
    }
    printk("Provisioning completed\n");
    return 0;
}

static int self_configure()
{
    int err;
    printk("configuring...\n");

    /* Add Application Key to root models*/
    err = bt_mesh_cfg_app_key_add(net_idx, ROOT_ADDR, net_idx, app_idx, app_key, NULL);
    if (err) {
        printk("ERROR adding appkey (err %d)\n", err);
        return err;
    } else {
        printk("added appkey\n");
    }

    /* Bind to generic onoff server model */
    err = bt_mesh_cfg_mod_app_bind(net_idx, ROOT_ADDR, LED_ADDR, app_idx,
                                   BT_MESH_MODEL_ID_GEN_ONOFF_SRV, NULL);
    if (err) {
        printk("ERROR binding to generic onoff server model (err %d)\n", err);
        return err;
    } else {
        printk("bound appkey to generic onoff server model\n");
    }

    /* Bind to Health model */
    err = bt_mesh_cfg_mod_app_bind(net_idx, ROOT_ADDR, ROOT_ADDR, app_idx,
                                   BT_MESH_MODEL_ID_HEALTH_SRV, NULL);
    if (err) {
        printk("ERROR binding to health server model (err %d)\n", err);
        return err;
    } else {
        printk("bound appkey to health server model\n");
    }

    // subscribe srv model to the group address
    err = bt_mesh_cfg_mod_sub_add(net_idx, ROOT_ADDR, LED_ADDR, GROUP_ADDR,
                                  BT_MESH_MODEL_ID_GEN_ONOFF_SRV, NULL);
    if (err) {
        printk("ERROR subscribing to group address (err %d)\n", err);
        return err;
    } else {
        printk("subscribed to group address\n");
    }

    /* Bind to generic onoff client model */
    err = bt_mesh_cfg_mod_app_bind(net_idx, ROOT_ADDR, BUTTON_ADDR, app_idx,
                                   BT_MESH_MODEL_ID_GEN_ONOFF_CLI, NULL);
    if (err) {
        printk("ERROR binding to generic onoff client model (err %d)\n", err);
        return err;
    } else {
        printk("bound appkey to generic onoff server model\n");
    }

    // subscribe cli model to the group address
    err = bt_mesh_cfg_mod_sub_add(net_idx, ROOT_ADDR, BUTTON_ADDR, GROUP_PUB_ADDR,
                                  BT_MESH_MODEL_ID_GEN_ONOFF_CLI, NULL);
    if (err) {
        printk("ERROR subscribing to group address (err %d)\n", err);
        return err;
    } else {
        printk("subscribed to group address\n");
    }

    // publish cli and srv model to its respective groups addresses
    pub_onoff_cli.addr = GROUP_ADDR;
    pub_onoff_srv.addr = GROUP_PUB_ADDR;

    return 0;
}


static void bt_ready(int err)
{
    if (err) {
        printk("bt_enable init failed with err %d\n", err);
        return;
    }

    printk("Bluetooth initialised OK\n");

    // self-provision and initialise with node composition data
    err = bt_mesh_init(&prov, &comp);
    if (err) {
        printk("bt_mesh_init failed with err %d\n", err);
        return;
    }

    err = self_provision();
    if (err) {
        printk("ERROR: SELF-PROVISIONING FAILED");
    } else {
        printk("self-provisioned OK\n");
    }

    err = self_configure();

    if (err) {
        printk("ERROR: INITIALISATION FAILED");
    } else {
        printk("Mesh initialised OK\n");
    }
}

void main(void)
{
    printk("Firmware version: %d.%d.%d\n", ic_version_get_major(), ic_version_get_minor(),
           ic_version_get_build());

    int err;
    err = configure_board();
    if (err) {
        return;
    }

    err = bt_enable(bt_ready);
    if (err) {
        printk("bt_enable failed with err %d\n", err);
        return;
    }

    while (1) {
        k_sleep(SLEEP_TIME);
    }
}
```

## include/ic_bt.h
```c
/**
 * @file ic_bt.h
 * @Lucas Peixoto (lpdac@ic.ufal.br)
 * @brief
 * @version 0.1
 * @date 2018-12-25
 *
 * @copyright Copyright (c) 2018
 *
 */

#ifndef _IC_BT_H
#define _IC_BT_H

#include <bluetooth/bluetooth.h>
#include <bluetooth/mesh.h>
#include <misc/printk.h>
#include <settings/settings.h>


extern const struct bt_mesh_model_op generic_onoff_cli_op[];
extern const struct bt_mesh_model_op generic_onoff_srv_op[];
extern const struct bt_mesh_model_op generic_level_srv_op[];
extern const struct bt_mesh_model_op generic_level_cli_op[];

// Generic OnOff Messages Types
#define BT_MESH_MODEL_OP_GENERIC_ONOFF_GET BT_MESH_MODEL_OP_2(0x82, 0x01)
#define BT_MESH_MODEL_OP_GENERIC_ONOFF_SET BT_MESH_MODEL_OP_2(0x82, 0x02)
#define BT_MESH_MODEL_OP_GENERIC_ONOFF_SET_UNACK BT_MESH_MODEL_OP_2(0x82, 0x03)
#define BT_MESH_MODEL_OP_GENERIC_ONOFF_STATUS BT_MESH_MODEL_OP_2(0x82, 0x04)


#define BT_MESH_MODEL_OP_GENERIC_LEVEL_GET BT_MESH_MODEL_OP_2(0x82, 0x05)
#define BT_MESH_MODEL_OP_GENERIC_LEVEL_SET BT_MESH_MODEL_OP_2(0x82, 0x06)
#define BT_MESH_MODEL_OP_GENERIC_LEVEL_SET_UNACK BT_MESH_MODEL_OP_2(0x82, 0x07)
#define BT_MESH_MODEL_OP_GENERIC_LEVEL_STATUS BT_MESH_MODEL_OP_2(0x82, 0x08)

#define IS_SERVER_ONOFF 0x100
#define IS_CLIENT_ONOFF 0x101
#define IS_SERVER_AND_CLIENT_ONOFF 0x110

#define S16_MIN -32768
#define S16_MAX 32767

#define LEVEL_MIN 0
#define LEVEL_MAX 20000

#define map(var, _out_type, _x, _in_min, _in_max, _out_min, _out_max) \
    var = (_out_type)((_x - _in_min) * (_out_max - _out_min) / (_in_max - _in_min) + _out_min)

struct onoff_srv {
    u8_t *state;
    u8_t tid;
    void (*set_state)(u8_t value);
};

struct onoff_cli {
    struct bt_mesh_model *model_cli;
    struct k_work callback_work;
    u8_t state;
    u8_t act;
    u8_t tid;
};

struct level_srv {
    u16_t *level_state;
    u8_t tid;
    void (*set_level)(u16_t pulse_width);
};

struct level_cli {
    struct bt_mesh_model *model_cli;
    struct k_work callback_work;
    u16_t *level_state;
    u16_t act;
    u8_t tid;
};

/**
 * @brief
 *
 * @param model
 * @param ctx
 * @param buf
 */
void generic_onoff_get(struct bt_mesh_model *model, struct bt_mesh_msg_ctx *ctx,
                       struct net_buf_simple *buf);


/**
 * @brief
 *
 * @param model
 * @param ctx
 * @param buf
 */
void generic_onoff_set(struct bt_mesh_model *model, struct bt_mesh_msg_ctx *ctx,
                       struct net_buf_simple *buf);


/**
 * @brief
 *
 * @param model
 * @param ctx
 * @param buf
 */
void generic_onoff_set_unack(struct bt_mesh_model *model, struct bt_mesh_msg_ctx *ctx,
                             struct net_buf_simple *buf);

void generic_onoff_status(struct bt_mesh_model *model, struct bt_mesh_msg_ctx *ctx,
                          struct net_buf_simple *buf);

/**
 * @brief
 *
 * @param model
 * @param ctx
 * @param buf
 */
void generic_level_get(struct bt_mesh_model *model, struct bt_mesh_msg_ctx *ctx,
                       struct net_buf_simple *buf);


/**
 * @brief
 *
 * @param model
 * @param ctx
 * @param buf
 */
void generic_level_set(struct bt_mesh_model *model, struct bt_mesh_msg_ctx *ctx,
                       struct net_buf_simple *buf);


/**
 * @brief
 *
 * @param model
 * @param ctx
 * @param buf
 */
void generic_level_set_unack(struct bt_mesh_model *model, struct bt_mesh_msg_ctx *ctx,
                             struct net_buf_simple *buf);


/**
 * @brief
 *
 * @param model
 * @param ctx
 * @param buf
 */
void generic_level_status(struct bt_mesh_model *model, struct bt_mesh_msg_ctx *ctx,
                          struct net_buf_simple *buf);

void send_generic_onoff_set(struct onoff_cli *bt_cli, u16_t message_type);


void send_generic_onoff_get(struct onoff_cli *bt_cli, u16_t message_type);


void send_generic_level_set(struct level_cli *bt_cli, u16_t message_type);

void send_generic_level_get(struct level_cli *bt_cli, u16_t message_type);

// u16_t map_level(s16_t x, s16_t in_min, s16_t in_max, u16_t out_min, u16_t out_max);

#endif
```

## include/ic_buttons.h
```c
/**!
 * @file ic_buttons.h
 * @author Geymerson Ramos (geymerson@ic.ufal.br)
 * @brief
 * @version 0.1
 * @date 2018-12-15
 *
 * @copyright Copyright (c) IC 2018
 *
 */

#ifndef _IC_BUTTONS_H_
#define _IC_BUTTONS_H_

#include <device.h>
#include <gpio.h>
#include <logging/sys_log.h>
#include <misc/util.h>
#include <zephyr/types.h>


/* change to use another GPIO pin interrupt config */
#ifdef SW0_GPIO_FLAGS
#define EDGE (SW0_GPIO_FLAGS | GPIO_INT_EDGE)
#else
/*
 * If SW0_GPIO_FLAGS not defined used default EDGE value.
 * Change this to use a different interrupt trigger
 */
#define EDGE (GPIO_INT_EDGE | GPIO_INT_ACTIVE_LOW)
#endif


/* change this to enable pull-up/pull-down */
#ifdef SW0_GPIO_PIN_PUD
#define PULL_UP SW0_GPIO_PIN_PUD
#else
#define PULL_UP 0
#endif

// Buttons GPIO communication PORT
#define BUTTONS_PORT SW0_GPIO_CONTROLLER

// Defining buttons pins
#define BUTTON0 SW0_GPIO_PIN
#define BUTTON1 SW1_GPIO_PIN
#define BUTTON2 SW2_GPIO_PIN
#define BUTTON3 SW3_GPIO_PIN

#define BUTTON_NUMBERS 4
#define BUTTON_DEBOUNCE_DELAY_MS 250

// Buttons device struct
typedef struct {
    struct device *ic_device;
    struct gpio_callback ic_device_cb;
    u8_t initiated;
} ic_buttons_device_t;

extern u32_t time;
extern u32_t last_time;

extern ic_buttons_device_t buttons_dev;
extern struct k_work pressed_work[BUTTON_NUMBERS];

extern void button1_handler(struct k_work *work);
extern void button2_handler(struct k_work *work);
extern void button3_handler(struct k_work *work);
extern void button4_handler(struct k_work *work);


/**
 * @brief initiate buttons device
 *
 * This function configures the buttons' device communication port.
 * If the device was not initialized, no other function can be called
 *
 * @param buttons_device
 * @ret 0 if the communication was successffuly initialized, otherwise return an error
 */
int ic_buttons_init_device(ic_buttons_device_t *buttons_device);


/**
 * @brief configures all the buttons pins
 *
 * This function configures the buttons' as input or output, active if HIGH or LOW, etc
 *
 * @param buttons_device
 */
int ic_buttons_configure(ic_buttons_device_t *buttons_device);


/**
 * @brief configures callback
 *
 * This function is used to initiate, add and enable callbacks
 *
 * @param buttons_device
 * @param callback_function
 */
int ic_buttons_configure_callback(ic_buttons_device_t *buttons_device,
                                  gpio_callback_handler_t callback_function);


extern void ic_buttons_callback(struct device *buttons_device, struct gpio_callback *callback,
                                u32_t button_pin_mask);

uint8_t ic_buttons_pin_to_i(uint32_t pin_pos);

#endif  // _IC_BUTTONS_H_
```

## include/ic_leds.h
```c
/**!
 * @file ic_leds.h
 * @author Geymerson Ramos (geymerson@ic.ufal.br)
 * @brief
 * @version 0.1
 * @date 2018-12-15
 *
 * @copyright Copyright (c) IC 2018
 *
 */
#ifndef _IC_LEDS_H_
#define _IC_LEDS_H_

#include <device.h>
#include <gpio.h>
#include <logging/sys_log.h>
#include <zephyr/types.h>

#define LOW 1
#define HIGH 0

// Configure LED GPIO communication port
#define LED_PORT LED0_GPIO_CONTROLLER

// Configure LED GPIO PIN
#define LED0 LED0_GPIO_PIN
#define LED1 LED1_GPIO_PIN
#define LED2 LED2_GPIO_PIN
#define LED3 LED3_GPIO_PIN


typedef struct {
    struct device *ic_device;
    u8_t initiated;
} ic_leds_device_t;

extern u8_t leds_states[4];
extern ic_leds_device_t leds_dev;

/**
 * @brief initiate buttons device
 *
 * This function configures the leds' device communication port.
 * If the device was not initialized, no other function can be called
 *
 * @param leds_device
 * @ret 0 if the communication was successffuly initialized, otherwise return an error
 */
int ic_leds_init_device(ic_leds_device_t *leds_device);

/**
 * @brief Checks if led_pin_mask is a valid led pin number
 *
 * @param leds_device
 * @ret 1 if the led_pin_mask is a valid value, otherwise return 0
 */
int ic_leds_valid_pin_mask(u32_t led_pin_mask);


/**
 * @brief configures all the leds pins
 *
 * This function configures the leds' as input or output, active if HIGH or LOW, etc
 *
 * @param leds_device
 */
int ic_leds_configure(ic_leds_device_t *leds_device);

/**
 * @brief Turn on all the leds
 *
 * @param leds_device
 */
int ic_leds_turn_all_leds_on(ic_leds_device_t *leds_device);

/**
 * @brief Turn off all the leds
 *
 * @param leds_device
 */


int ic_leds_turn_all_leds_off(ic_leds_device_t *leds_device);

/**
 * @brief Turn on the specific led with pin address value = led_pin_mask
 *
 * @param leds_device
 * @param led_pin_mask
 */
int ic_leds_turn_on_led(ic_leds_device_t *leds_device, u32_t led_pin_mask);

/**
 * @brief Turn off the specific led with pin address value = led_pin_mask
 *
 * @param leds_device
 * @param led_pin_mask
 */
int ic_leds_turn_off_led(ic_leds_device_t *leds_device, u32_t led_pin_mask);

#endif  // _IC_LEDS_H_
```

## include/ic_version.h
```c
/**!
 * @file ic_version.h
 * @author Rodrigo Peixoto (rodrigopex@ic.ufal.br)
 * @brief
 * @version 0.1
 * @date 2018-11-21
 *
 * @copyright Copyright (c) ic.ufal.br 2018
 *
 */
#ifndef _IC_VERSION_H_
#define _IC_VERSION_H_

#include <zephyr/types.h>

typedef struct {
    u8_t major;
    u8_t minor;
    u16_t build;
} ic_version_t;

const ic_version_t *ic_version_instance();
u8_t ic_version_get_major();
u8_t ic_version_get_minor();
u16_t ic_version_get_build();

#endif  // _IC_VERSION_H_
```

## src/ic_bt.c
```c
/**
 * @file ic_bt.c
 * @Lucas Peixoto (lpdac@ic.ufal.br)
 * @brief
 * @version 0.1
 * @date 2018-12-25
 *
 * @copyright Copyright (c) 2018
 *
 */

#include "ic_bt.h"

const struct bt_mesh_model_op generic_onoff_cli_op[] = {
    {BT_MESH_MODEL_OP_GENERIC_ONOFF_STATUS, 1, generic_onoff_status},
    BT_MESH_MODEL_OP_END,
};

const struct bt_mesh_model_op generic_onoff_srv_op[] = {
    {BT_MESH_MODEL_OP_GENERIC_ONOFF_GET, 0, generic_onoff_get},
    {BT_MESH_MODEL_OP_GENERIC_ONOFF_SET, 2, generic_onoff_set},
    {BT_MESH_MODEL_OP_GENERIC_ONOFF_SET_UNACK, 2, generic_onoff_set_unack},
    BT_MESH_MODEL_OP_END,
};
const struct bt_mesh_model_op generic_level_srv_op[] = {
    {BT_MESH_MODEL_OP_GENERIC_LEVEL_GET, 0, generic_level_get},
    {BT_MESH_MODEL_OP_GENERIC_LEVEL_SET, 2, generic_level_set},
    {BT_MESH_MODEL_OP_GENERIC_LEVEL_SET_UNACK, 2, generic_level_set_unack},
    BT_MESH_MODEL_OP_END,
};

const struct bt_mesh_model_op generic_level_cli_op[] = {
    {BT_MESH_MODEL_OP_GENERIC_LEVEL_STATUS, 1, generic_level_status},
    BT_MESH_MODEL_OP_END,
};

void generic_onoff_get(struct bt_mesh_model *model, struct bt_mesh_msg_ctx *ctx,
                       struct net_buf_simple *buf)
{
    printk("[0x%04x]: Received a get msg from group address 0x%04x, sended by 0x%04x.\n",
           bt_mesh_model_elem(model)->addr, ctx->recv_dst, ctx->addr);
    struct bt_mesh_model_pub *pub_cli;
    pub_cli                    = model->pub;
    struct onoff_srv *cur_elem = model->user_data;


    // 2 bytes for the opcode
    // 1 bytes parameters: present onoff value
    // 2 optional bytes for target onoff and remaining time
    // 4 additional bytes for the TransMIC


    printk("Sending onoff status msg to 0x%04x, value -> %d\n", pub_cli->addr, !*cur_elem->state);
    bt_mesh_model_msg_init(pub_cli->msg, BT_MESH_MODEL_OP_GENERIC_ONOFF_STATUS);
    net_buf_simple_add_u8(pub_cli->msg, *cur_elem->state);
    int err = bt_mesh_model_publish(model);
    if (err) {
        printk("bt_mesh_model_publish err %d, sending msg to 0x%04x\n", err, pub_cli->addr);
    }
}


void generic_onoff_set(struct bt_mesh_model *model, struct bt_mesh_msg_ctx *ctx,
                       struct net_buf_simple *buf)
{
    generic_onoff_set_unack(model, ctx, buf);
    generic_onoff_get(model, ctx, buf);
}


void generic_onoff_set_unack(struct bt_mesh_model *model, struct bt_mesh_msg_ctx *ctx,
                             struct net_buf_simple *buf)
{
    printk("[0x%04x]: Received a set msg from group address 0x%04x, sended by 0x%04x.\n",
           bt_mesh_model_elem(model)->addr, ctx->recv_dst, ctx->addr);
    struct onoff_srv *elem = model->user_data;
    u8_t buflen            = buf->len;
    u8_t new_onoff_state   = net_buf_simple_pull_u8(buf);
    u8_t tid               = net_buf_simple_pull_u8(buf);

    if (buflen > 2) {
        printk("[wrn]: message contains transition_time field - processing not implemented\n");
    }

    if (buflen > 3) {
        printk("[wrn]: message contains delay field - processing not implemented\n");
    }

    elem->set_state(new_onoff_state);
    printk("[0x%04x]: Value msg -> %d/ TID -> %d\n", bt_mesh_model_elem(model)->addr,
           !new_onoff_state, tid);
}


void generic_onoff_status(struct bt_mesh_model *model, struct bt_mesh_msg_ctx *ctx,
                          struct net_buf_simple *buf)
{
    u8_t state            = net_buf_simple_pull_u8(buf);
    struct onoff_cli *cli = model->user_data;
    cli->state            = state;

    printk("Node 0x%04x OnOff status from 0x%04x with state 0x%02x\n",
           bt_mesh_model_elem(model)->addr, ctx->addr, !state);
}


void generic_level_get(struct bt_mesh_model *model, struct bt_mesh_msg_ctx *ctx,
                       struct net_buf_simple *buf)
{
    printk("[0x%04x]: Received a get level msg from group address 0x%04x, sended by 0x%04x.\n",
           bt_mesh_model_elem(model)->addr, ctx->recv_dst, ctx->addr);
    struct bt_mesh_model_pub *pub_cli;
    pub_cli                = model->pub;
    struct level_srv *elem = model->user_data;
    map(s16_t level, s16_t, *elem->level_state, 0, LEVEL_MAX, S16_MIN, S16_MAX);
    map(s16_t level_perc, s16_t, level, S16_MIN, S16_MAX, 0, 100);

    // 2 bytes for the opcode
    // 1 bytes parameters: present onoff value
    // 2 optional bytes for target onoff and remaining time
    // 4 additional bytes for the TransMIC

    printk("Sending level status msg to 0x%04x, value -> %d\n", pub_cli->addr, level_perc);
    bt_mesh_model_msg_init(pub_cli->msg, BT_MESH_MODEL_OP_GENERIC_LEVEL_STATUS);
    net_buf_simple_add_le16(pub_cli->msg, level);
    int err = bt_mesh_model_publish(model);
    if (err) {
        printk("bt_mesh_model_publish err %d, sending msg to 0x%04x\n", err, pub_cli->addr);
    }
}


void generic_level_set(struct bt_mesh_model *model, struct bt_mesh_msg_ctx *ctx,
                       struct net_buf_simple *buf)
{
    generic_level_set_unack(model, ctx, buf);
    generic_level_get(model, ctx, buf);
}


void generic_level_set_unack(struct bt_mesh_model *model, struct bt_mesh_msg_ctx *ctx,
                             struct net_buf_simple *buf)
{
    printk("[0x%04x]: Received a set level msg from group address 0x%04x, sended by 0x%04x.\n",
           bt_mesh_model_elem(model)->addr, ctx->recv_dst, ctx->addr);
    struct level_srv *elem = model->user_data;
    u8_t buflen            = buf->len;
    s16_t new_level_state  = net_buf_simple_pull_le16(buf);
    u8_t tid               = net_buf_simple_pull_u8(buf);
    map(u16_t new_pulse_state, u16_t, new_level_state, S16_MIN, S16_MAX, 0, LEVEL_MAX);
    map(u16_t new_pulse_state_perc, u16_t, new_pulse_state, 0, LEVEL_MAX, 0, 100);

    if (buflen > 3) {
        printk("[wrn]: message contains transition_time field - processing not implemented\n");
    }

    if (buflen > 4) {
        printk("[wrn]: message contains delay field - processing not implemented\n");
    }

    elem->set_level(new_pulse_state);
    printk("[0x%04x]: Value msg -> %d / TID -> %d\n", bt_mesh_model_elem(model)->addr,
           new_pulse_state_perc, tid);
}


void generic_level_status(struct bt_mesh_model *model, struct bt_mesh_msg_ctx *ctx,
                          struct net_buf_simple *buf)
{
    s16_t level_signed       = net_buf_simple_pull_le16(buf);
    struct level_cli *bt_cli = model->user_data;
    map(u16_t level_unsigned, u16_t, level_signed, S16_MIN, S16_MAX, 0, LEVEL_MAX);
    map(u16_t perc, u16_t, level_unsigned, 0, LEVEL_MAX, 0, 100);

    *bt_cli->level_state = level_unsigned;
    printk("Node 0x%04x level status from 0x%04x with level %d\n", bt_mesh_model_elem(model)->addr,
           ctx->addr, perc);
}

void send_generic_onoff_get(struct onoff_cli *bt_cli, u16_t message_type)
{
    struct bt_mesh_model_pub *pub_cli;
    pub_cli = bt_cli->model_cli->pub;
    printk("Sending onoff get msg to 0x%04x\n", pub_cli->addr);
    bt_mesh_model_msg_init(pub_cli->msg, message_type);
    int err = bt_mesh_model_publish(bt_cli->model_cli);
    if (err) {
        printk("bt_mesh_model_publish err %d, sending msg to 0x%04x\n", err, pub_cli->addr);
    }
}

void send_generic_onoff_set(struct onoff_cli *cli, u16_t message_type)
{
    struct bt_mesh_model_pub *pub_cli;
    pub_cli = cli->model_cli->pub;
    printk("Sending onoff set msg to 0x%04x, value -> %d\n", pub_cli->addr, !cli->act);
    bt_mesh_model_msg_init(pub_cli->msg, message_type);
    net_buf_simple_add_u8(pub_cli->msg, cli->act);
    net_buf_simple_add_u8(pub_cli->msg, cli->tid++);
    int err = bt_mesh_model_publish(cli->model_cli);
    if (err) {
        printk("bt_mesh_model_publish err %d, sending msg to 0x%04x\n", err, pub_cli->addr);
    }
}

void send_generic_level_set(struct level_cli *bt_cli, u16_t message_type)
{
    struct bt_mesh_model_pub *pub_cli;
    pub_cli = bt_cli->model_cli->pub;
    map(s16_t level, s16_t, bt_cli->act, 0, LEVEL_MAX, S16_MIN, S16_MAX);
    map(s16_t level_perc, s16_t, level, S16_MIN, S16_MAX, 0, 100);
    printk("Sending level set msg to 0x%04x, value -> %d\n", pub_cli->addr, level_perc);
    bt_mesh_model_msg_init(pub_cli->msg, message_type);
    net_buf_simple_add_le16(pub_cli->msg, level);
    net_buf_simple_add_u8(pub_cli->msg, bt_cli->tid++);
    int err = bt_mesh_model_publish(bt_cli->model_cli);
    if (err) {
        printk("bt_mesh_model_publish err %d, sending msg to 0x%04x\n", err, pub_cli->addr);
    }
}
void send_generic_level_get(struct level_cli *bt_cli, u16_t message_type)
{
    struct bt_mesh_model_pub *pub_cli;
    pub_cli = bt_cli->model_cli->pub;
    printk("Sending level get msg to 0x%04x\n", pub_cli->addr);
    bt_mesh_model_msg_init(pub_cli->msg, message_type);
    int err = bt_mesh_model_publish(bt_cli->model_cli);
    if (err) {
        printk("bt_mesh_model_publish err %d, sending msg to 0x%04x\n", err, pub_cli->addr);
    }
}
```

## src/ic_buttons.c
```c
/**
 * @file ic_buttons.c
 * @Lucas Peixoto (lpdac@ic.ufal.br)
 * @brief
 * @version 0.1
 * @date 2018-12-17
 *
 * @copyright Copyright (c) 2018
 *
 */
#include "ic_buttons.h"

int ic_buttons_init_device(ic_buttons_device_t *buttons_device)
{
    if (buttons_device->initiated != 0) {
        return -EBUSY;
    }
    struct device *buttons_dev;
    struct gpio_callback gpio_cb;
    buttons_dev                  = device_get_binding(BUTTONS_PORT);
    buttons_device->ic_device    = buttons_dev;
    buttons_device->ic_device_cb = gpio_cb;
    buttons_device->initiated    = 1;
    return 0;
}

int ic_buttons_configure(ic_buttons_device_t *buttons_device)
{
    if (buttons_device->initiated != 1) {
        return -ENODEV;
    }

    gpio_pin_configure(buttons_device->ic_device, BUTTON0, GPIO_DIR_IN | GPIO_INT | PULL_UP | EDGE);

    gpio_pin_configure(buttons_device->ic_device, BUTTON1, GPIO_DIR_IN | GPIO_INT | PULL_UP | EDGE);

    gpio_pin_configure(buttons_device->ic_device, BUTTON2, GPIO_DIR_IN | GPIO_INT | PULL_UP | EDGE);

    gpio_pin_configure(buttons_device->ic_device, BUTTON3, GPIO_DIR_IN | GPIO_INT | PULL_UP | EDGE);


    return 0;
}

int ic_buttons_configure_callback(ic_buttons_device_t *buttons_device,
                                  gpio_callback_handler_t callback_function)
{
    if (buttons_device->initiated != 1) {
        return -ENODEV;
    }
    gpio_init_callback(&buttons_device->ic_device_cb, callback_function,
                       BIT(BUTTON0) | BIT(BUTTON1) | BIT(BUTTON2) | BIT(BUTTON3));
    gpio_add_callback(buttons_device->ic_device, &buttons_device->ic_device_cb);
    gpio_pin_enable_callback(buttons_device->ic_device, BUTTON0);
    gpio_pin_enable_callback(buttons_device->ic_device, BUTTON1);
    gpio_pin_enable_callback(buttons_device->ic_device, BUTTON2);
    gpio_pin_enable_callback(buttons_device->ic_device, BUTTON3);
    return 0;
}


uint8_t ic_buttons_pin_to_i(uint32_t pin_pos)
{
    switch (pin_pos) {
    case BIT(BUTTON0):
        return 0;
    case BIT(BUTTON1):
        return 1;
    case BIT(BUTTON2):
        return 2;
    case BIT(BUTTON3):
        return 3;
    default:
        printk("No match for GPIO pin 0x%08x\n", pin_pos);
        return -EINVAL;
    }
    return 0;
}
```

## src/ic_leds.c
```c
/**
 * @file ic_leds.c
 * @Lucas Peixoto(lpdac@ic.ufal.br)
 * @brief
 * @version 0.1
 * @date 2018-12-17
 *
 * @copyright Copyright (c) 2018
 *
 */
#include "ic_leds.h"


int ic_leds_init_device(ic_leds_device_t *leds_device)
{
    if (leds_device->initiated != 0) {
        return -EBUSY;
    }
    struct device *led_dev;
    led_dev                = device_get_binding(LED_PORT);
    leds_device->ic_device = led_dev;
    leds_device->initiated = 1;
    return 0;
}

int ic_leds_configure(ic_leds_device_t *leds_device)
{
    if (leds_device->initiated != 1) {
        return -ENODEV;
    }
    gpio_pin_configure(leds_device->ic_device, LED0,
                       GPIO_DIR_OUT | GPIO_PUD_PULL_UP | GPIO_INT_ACTIVE_HIGH);

    gpio_pin_configure(leds_device->ic_device, LED1,
                       GPIO_DIR_OUT | GPIO_PUD_PULL_UP | GPIO_INT_ACTIVE_HIGH);

    gpio_pin_configure(leds_device->ic_device, LED2,
                       GPIO_DIR_OUT | GPIO_PUD_PULL_UP | GPIO_INT_ACTIVE_HIGH);

    gpio_pin_configure(leds_device->ic_device, LED3,
                       GPIO_DIR_OUT | GPIO_PUD_PULL_UP | GPIO_INT_ACTIVE_HIGH);


    return 0;
}

int ic_leds_valid_pin_mask(u32_t led_pin_mask)
{
    if (led_pin_mask == LED0 || led_pin_mask == LED1 || led_pin_mask == LED2
        || led_pin_mask == LED3) {
        return 1;
    }
    return 0;
}


int ic_leds_turn_all_leds_on(ic_leds_device_t *leds_device)
{
    if (leds_device->initiated != 1) {
        return -ENODEV;
    }
    gpio_pin_write(leds_device->ic_device, LED0, HIGH);
    leds_states[0] = HIGH;
    gpio_pin_write(leds_device->ic_device, LED1, HIGH);
    leds_states[1] = HIGH;
    gpio_pin_write(leds_device->ic_device, LED2, HIGH);
    leds_states[2] = HIGH;
    gpio_pin_write(leds_device->ic_device, LED3, HIGH);
    leds_states[3] = HIGH;
    return 0;
}

int ic_leds_turn_all_leds_off(ic_leds_device_t *leds_device)
{
    if (leds_device->initiated != 1) {
        return -ENODEV;
    }

    gpio_pin_write(leds_device->ic_device, LED0, LOW);
    leds_states[0] = LOW;
    gpio_pin_write(leds_device->ic_device, LED1, LOW);
    leds_states[1] = LOW;
    gpio_pin_write(leds_device->ic_device, LED2, LOW);
    leds_states[2] = LOW;
    gpio_pin_write(leds_device->ic_device, LED3, LOW);
    leds_states[3] = LOW;
    return 0;
}

int ic_leds_turn_on_led(ic_leds_device_t *leds_device, u32_t led_pin_mask)
{
    if (leds_device->initiated != 1) {
        return -ENODEV;
    }
    if (led_pin_mask == LED0) {
        leds_states[0] = HIGH;
    } else if (led_pin_mask == LED1) {
        leds_states[1] = HIGH;
    } else if (led_pin_mask == LED2) {
        leds_states[2] = HIGH;
    } else if (led_pin_mask == LED3) {
        leds_states[3] = HIGH;
    } else {
        return -ENOTSUP;
    }
    gpio_pin_write(leds_device->ic_device, led_pin_mask, HIGH);
    return 0;
}

int ic_leds_turn_off_led(ic_leds_device_t *leds_device, u32_t led_pin_mask)
{
    if (leds_device->initiated != 1) {
        return -ENODEV;
    }
    if (led_pin_mask == LED0) {
        leds_states[0] = LOW;
    } else if (led_pin_mask == LED1) {
        leds_states[1] = LOW;
    } else if (led_pin_mask == LED2) {
        leds_states[2] = LOW;
    } else if (led_pin_mask == LED3) {
        leds_states[3] = LOW;
    } else {
        return -ENOTSUP;
    }
    gpio_pin_write(leds_device->ic_device, led_pin_mask, LOW);
    return 0;
}
```

## src/ic_version.c
```c
#include "ic_version.h"

#include "firmware_version.h"

static const ic_version_t __version = {VERSION_MAJOR, VERSION_MINOR, VERSION_BUILD};

const ic_version_t *ic_version_instance()
{
    return &__version;
}

u8_t ic_version_get_major()
{
    return __version.major;
}

u8_t ic_version_get_minor()
{
    return __version.minor;
}
u16_t ic_version_get_build()
{
    return __version.build;
}
```
